## firmware/main/Kconfig.projbuild
```kconfig
menu "BNO055 settings"

    config BNO055_I2C_SDA_GPIO
        int "I2C SDA GPIO (XIAO D4 = GPIO6)"
        range 0 21
        default 6

    config BNO055_I2C_SCL_GPIO
        int "I2C SCL GPIO (XIAO D5 = GPIO7)"
        range 0 21
        default 7

    config BNO055_I2C_FREQUENCY_HZ
        int "I2C frequency (Hz)"
        range 10000 400000
        default 100000
        help
            Start at 100 kHz. Faster I2C does not increase the NDOF output rate.

    config BNO055_OUTPUT_INTERVAL_MS
        int "Polling interval (ms)"
        range 10 60000
        default 10
        help
            NDOF fusion output updates nominally at 100 Hz (10 ms).

    config BNO055_TIMING_REPORT_INTERVAL_MS
        int "Timing report interval (ms, 0 disables)"
        range 0 60000
        default 5000
        help
            Reports polling rate, read/log duration and schedule overruns.

endmenu
```

## firmware/sdkconfig.defaults
```kconfig
# Seeed Studio XIAO ESP32-C3, BNO055 over I2C.
CONFIG_BNO055_I2C_SDA_GPIO=6
CONFIG_BNO055_I2C_SCL_GPIO=7
CONFIG_BNO055_I2C_FREQUENCY_HZ=100000
CONFIG_BNO055_OUTPUT_INTERVAL_MS=10
CONFIG_BNO055_TIMING_REPORT_INTERVAL_MS=5000
CONFIG_FREERTOS_HZ=1000
CONFIG_ESPTOOLPY_FLASHSIZE_4MB=y
CONFIG_ESPTOOLPY_FLASHSIZE="4MB"
CONFIG_ESP_CONSOLE_USB_SERIAL_JTAG=y
CONFIG_ESP_CONSOLE_SECONDARY_NONE=y
CONFIG_ESPTOOLPY_MONITOR_BAUD=115200
CONFIG_LOG_COLORS=n
```

## src/Kconfig.projbuild
```kconfig
menu "BNO055 settings"

    config BNO055_I2C_SDA_GPIO
        int "I2C SDA GPIO"
        range 0 21
        default 6
        help
            XIAO ESP32-C3 D4 is GPIO6.

    config BNO055_I2C_SCL_GPIO
        int "I2C SCL GPIO"
        range 0 21
        default 7
        help
            XIAO ESP32-C3 D5 is GPIO7.

    config BNO055_I2C_FREQUENCY_HZ
        int "I2C frequency (Hz)"
        range 10000 400000
        default 100000
        help
            BNO055 can be sensitive to I2C timing. Start at 100 kHz.

    config BNO055_OUTPUT_INTERVAL_MS
        int "Serial output interval (milliseconds)"
        range 50 60000
        default 500

endmenu
```
